## conf/machine/imx8mp-sr-som.conf
```bitbake
#@TYPE: Machine
#@NAME: SolidRun i.MX8M Plus SoM
#@SOC: i.MX8MP
#@DESCRIPTION: Machine configuration for SolidRun i.MX8M Plus SoM
#@MAINTAINER: Josua Mayer <josua@solid-run.com>

MACHINEOVERRIDES =. "mx8mp:solidrun-imx8:"

require conf/machine/include/imx-base.inc
require conf/machine/include/arm/armv8a/tune-cortexa53.inc
DEFAULTTUNE:imx8mp-sr-som ?= "cortexa53-crypto"
require conf/machine/include/arm/feature-arm-fp16.inc
TUNE_FEATURES:append:imx8mp-sr-som = " fp16"

MACHINE_FEATURES += "pci wifi bluetooth bcm43455"

# NXP BSP can consume proprietary jailhouse
# OP-TEE is also applicable to NXP BSP, mainline BSP seems not to have
# a full support for it yet.
MACHINE_FEATURES:append:use-nxp-bsp = " optee jailhouse"

KERNEL_DEVICETREE = " \
	freescale/imx8mp-cubox-m.dtb \
	freescale/imx8mp-hummingboard-iiot.dtb \
	freescale/imx8mp-hummingboard-iiot-panel-dsi-WJ70N3TYJHMNG0.dtbo \
	freescale/imx8mp-hummingboard-iiot-panel-lvds-WF70A8SYJHLNGA.dtbo \
	freescale/imx8mp-hummingboard-iiot-rs485-a.dtbo \
	freescale/imx8mp-hummingboard-iiot-rs485-b.dtbo \
	freescale/imx8mp-hummingboard-mate.dtb \
	freescale/imx8mp-hummingboard-pro.dtb \
	freescale/imx8mp-hummingboard-pulse.dtb \
	freescale/imx8mp-hummingboard-pulse-basler.dtbo \
	freescale/imx8mp-hummingboard-ripple.dtb \
	freescale/imx8mp-sr-som-basler.dtbo \
"
# HACK: place copy of kernel dtb in vendor subfolder as expected by u-boot
IMAGE_BOOT_FILES:append = " \
    imx8mp-cubox-m.dtb;freescale/imx8mp-cubox-m.dtb \
    imx8mp-hummingboard-iiot.dtb;freescale/imx8mp-hummingboard-iiot.dtb \
    imx8mp-hummingboard-iiot-panel-dsi-WJ70N3TYJHMNG0.dtbo;freescale/imx8mp-hummingboard-iiot-panel-dsi-WJ70N3TYJHMNG0.dtbo \
    imx8mp-hummingboard-iiot-panel-lvds-WF70A8SYJHLNGA.dtbo;freescale/imx8mp-hummingboard-iiot-panel-lvds-WF70A8SYJHLNGA.dtbo \
    imx8mp-hummingboard-iiot-rs485-a.dtbo;freescale/imx8mp-hummingboard-iiot-rs485-a.dtbo \
    imx8mp-hummingboard-iiot-rs485-b.dtbo;freescale/imx8mp-hummingboard-iiot-rs485-b.dtbo \
    imx8mp-hummingboard-mate.dtb;freescale/imx8mp-hummingboard-mate.dtb \
    imx8mp-hummingboard-pro.dtb;freescale/imx8mp-hummingboard-pro.dtb \
    imx8mp-hummingboard-pulse.dtb;freescale/imx8mp-hummingboard-pulse.dtb \
    imx8mp-hummingboard-pulse-basler.dtbo;freescale/imx8mp-hummingboard-pulse-basler.dtbo \
    imx8mp-hummingboard-ripple.dtb;freescale/imx8mp-hummingboard-ripple.dtb \
    imx8mp-sr-som-basler.dtbo;freescale/imx8mp-sr-som-basler.dtbo \
    "

UBOOT_DTB_NAME = "imx8mp-cubox-m.dtb"
UBOOT_EXTRA_DTB_NAMES = "imx8mp-cubox-m.dtb imx8mp-hummingboard-iiot.dtb imx8mp-hummingboard-mate.dtb imx8mp-hummingboard-pro.dtb imx8mp-hummingboard-pulse.dtb imx8mp-hummingboard-ripple.dtb"

IMX_DEFAULT_BOOTLOADER = "u-boot-imx"

UBOOT_SUFFIX = "bin"

UBOOT_CONFIG ??= "sd"
UBOOT_CONFIG[sd] = "imx8mp_solidrun_defconfig"

SPL_BINARY = "spl/u-boot-spl.bin"

ATF_PLATFORM = "imx8mp"

IMXBOOT_TARGETS = "flash_evk"

IMX_BOOT_SOC_TARGET = "iMX8MP"

SERIAL_CONSOLES = "115200;ttymxc1"

LOADADDR = ""
UBOOT_MAKE_TARGET = "all"
IMX_BOOT_SEEK = "32"

OPTEE_BIN_EXT = "8mp"
TEE_LOAD_ADDR = "0x56000000"

# Set DDR FIRMWARE
DDR_FIRMWARE_VERSION = "202006"
DDR_FIRMWARE_NAME = " \
    lpddr4_pmu_train_1d_dmem_${DDR_FIRMWARE_VERSION}.bin \
    lpddr4_pmu_train_1d_imem_${DDR_FIRMWARE_VERSION}.bin \
    lpddr4_pmu_train_2d_dmem_${DDR_FIRMWARE_VERSION}.bin \
    lpddr4_pmu_train_2d_imem_${DDR_FIRMWARE_VERSION}.bin \
"

# use modified kickstart file with generic distro-boot
WKS_FILE = "imx-boot-bootpart-distro.wks.in"

# Add additional firmware
MACHINE_FIRMWARE:append = " linux-firmware-cyw43455-sr linux-firmware-cyw55500-sr"

# include drivers & support packages
MACHINE_ESSENTIAL_EXTRA_RDEPENDS = " \
    kernel-module-af-alg \
    kernel-module-algif-hash \
    kernel-module-algif-skcipher \
    kernel-module-at24 \
    kernel-module-authenc \
    kernel-module-bluetooth \
    kernel-module-brcmfmac \
    kernel-module-brcmfmac-cyw \
    kernel-module-brcmutil \
    kernel-module-caam \
    kernel-module-caam-jr \
    kernel-module-caamalg-desc \
    kernel-module-caamhash-desc \
    kernel-module-caamkeyblob-desc \
    kernel-module-can-dev \
    kernel-module-cfg80211 \
    kernel-module-crct10dif-ce \
    kernel-module-crypto-engine \
    kernel-module-dw-hdmi-cec \
    kernel-module-ecc \
    kernel-module-ecdh-generic \
    kernel-module-error \
    kernel-module-flexcan \
    kernel-module-fsl-jr-uio \
    kernel-module-fuse \
    kernel-module-gpio-ir-recv \
    kernel-module-hci-uart \
    kernel-module-ilitek-ts-i2c \
    kernel-module-imx-pcm-dma \
    kernel-module-imx-sdma \
    kernel-module-led-class-multicolor \
    kernel-module-leds-lp5562 \
    kernel-module-leds-lp55xx-common \
    kernel-module-libdes \
    kernel-module-mux-gpio \
    kernel-module-onboard-usb-hub \
    kernel-module-overlay \
    kernel-module-panel-ronbo-rb070d30 \
    kernel-module-polyval-ce \
    kernel-module-polyval-generic \
    kernel-module-rc-core \
    kernel-module-rfkill \
    kernel-module-rfkill-gpio \
    kernel-module-rtc-abx80x \
    kernel-module-rtc-ds1307 \
    kernel-module-secvio \
    kernel-module-snd-soc-fsl-asoc-card \
    kernel-module-snd-soc-fsl-aud2htx \
    kernel-module-snd-soc-fsl-sai \
    kernel-module-snd-soc-fsl-utils \
    kernel-module-snd-soc-imx-audmux \
    kernel-module-snd-soc-imx-hdmi \
    kernel-module-snd-soc-wm8904 \
    kernel-module-spi-mux \
    kernel-module-tpm-tis-core \
    kernel-module-tpm-tis-spi \
    solidrun-udev-rules \
    ${MACHINE_FIRMWARE} \
"
# builtin:
# kernel-module-btbcm
# kernel-module-cfg80211
# kernel-module-fec
# kernel-module-hci-uart
# removed by cypress wifi driver patch
# kernel-module-brcmfmac-wcc

# add non-essential packages
MACHINE_EXTRA_RRECOMMENDS = ""

IMX_DEFAULT_BSP = "nxp"
```
