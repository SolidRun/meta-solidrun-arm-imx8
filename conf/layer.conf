## conf/layer.conf
```bitbake
# We have a conf and classes directory, add to BBPATH
BBPATH .= ":${LAYERDIR}"

# We have recipes-* directories, add to BBFILES
BBFILES += "${LAYERDIR}/recipes-*/*/*.bb \
            ${LAYERDIR}/recipes-*/*/*.bbappend"

BBFILE_COLLECTIONS += "solidrun-imx8"
BBFILE_PATTERN_solidrun-imx8 = "^${LAYERDIR}/"
BBFILE_PRIORITY_solidrun-imx8 = "15"
LAYERVERSION_solidrun-imx8 = "1"
LAYERSERIES_COMPAT_solidrun-imx8 = "scarthgap"

BBFILES_DYNAMIC += " \
    imx-machine-learning:${LAYERDIR}/dynamic-layers/meta-imx-ml/recipes-*/*/*.bb \
    imx-machine-learning:${LAYERDIR}/dynamic-layers/meta-imx-ml/recipes-*/*/*.bbappend \
    fsl-bsp-release:${LAYERDIR}/dynamic-layers/meta-imx-bsp/recipes-*/*/*.bb \
    fsl-bsp-release:${LAYERDIR}/dynamic-layers/meta-imx-bsp/recipes-*/*/*.bbappend \
    openembedded-layer:${LAYERDIR}/dynamic-layers/meta-oe/recipes-*/*/*.bb \
    openembedded-layer:${LAYERDIR}/dynamic-layers/meta-oe/recipes-*/*/*.bbappend \
"
```

## conf/machine/imx8dxl-sr-som.conf
```bitbake
#@TYPE: Machine
#@NAME: SolidRun i.MX 8DXL SoM
#@SOC: i.MX8DXL
#@DESCRIPTION: SolidRun i.MX 8DXLite SoM / HummingBoard
#@MAINTAINER: Josua Mayer <josua@solid-run.com>

MACHINEOVERRIDES =. "mx8dxl:"

require conf/machine/include/imx-base.inc
require conf/machine/include/arm/armv8a/tune-cortexa35.inc

IMX_DEFAULT_BSP = "nxp"

MACHINE_FEATURES:remove = " alsa touchscreen"
MACHINE_FEATURES:append = " bluetooth wifi optee"

# Don't include kernels in standard images
RRECOMMENDS:${KERNEL_PACKAGE_NAME}-base = ""

LOADADDR = ""

# Disable the serial console due to auto-serial-console
SERIAL_CONSOLES = "115200;ttyLP0"

# we do not want to have getty running on tty1 as we run
# auto-serial-console there
USE_VT = "0"

ATF_PLATFORM = "imx8dxl"
IMX_BOOT_SOC_TARGET = "iMX8DXL"

# This machine is not supported by u-boot-fslc, so we force it to use
# u-boot-imx here.
IMX_DEFAULT_BOOTLOADER = "u-boot-imx"

UBOOT_MAKE_TARGET = "all"
SPL_BINARY = "spl/u-boot-spl.bin"
UBOOT_SUFFIX = "bin"

# meta layer includes older u-boot-2020, pick 2022.04
PREFERRED_VERSION_u-boot-imx = "2022.04"
PREFERRED_VERSION_u-boot-fslc = "2022.04"

UBOOT_CONFIG ??= "emmc"
UBOOT_CONFIG[emmc] = "imx8dxl_v2x_defconfig,sdcard"

IMX_BOOT_SEEK = "32"

IMXBOOT_TARGETS = \
	"${@bb.utils.contains('MACHINE_FEATURES', 'optee', 'flash_spl', 'flash', d)}"

KERNEL_DEVICETREE:append:use-nxp-bsp = " \
	freescale/imx8dxl-v2x.dtb \
	freescale/imx8dxl-v2x-v11.dtb \
	freescale/imx8dxl-v2x-v11-som-v21.dtb \
"

# TODO: supply board-specific imx-sc-firmware
BOARD_TYPE = "evk"

# generate partitioned emmc disk image
WKS_FILE = "imx8dxl-emmc-data.wks"
IMAGE_FSTYPES:append = " wic wic.bmap"

# don't generate ubifs image (added by imx-v2x distro)
IMAGE_FSTYPES:remove = " ubi"

# include drivers & firmware
# BUG: MACHINE_EXTRA_RDEPENDS should be good enough ...
MACHINE_ESSENTIAL_EXTRA_RRECOMMENDS:append:imx8dxl-sr-som = " \
	kernel-module-authenc \
	kernel-module-brcmfmac \
	kernel-module-brcmutil \
	kernel-module-bridge \
	kernel-module-btbcm \
	kernel-module-caam \
	kernel-module-caam-jr \
	kernel-module-caamalg-desc \
	kernel-module-caamhash-desc \
	kernel-module-caamkeyblob-desc \
	kernel-module-can-dev \
	kernel-module-crct10dif-ce \
	kernel-module-crypto-engine \
	kernel-module-dsa-core \
	kernel-module-dwmac-imx \
	kernel-module-error \
	kernel-module-flexcan \
	kernel-module-fsl-jr-uio \
	kernel-module-fuse \
	kernel-module-g-ether \
	kernel-module-gnss \
	kernel-module-gnss-serial \
	kernel-module-gnss-ubx \
	kernel-module-gpio-pca953x \
	kernel-module-hci-uart \
	kernel-module-imx-sdma \
	kernel-module-libdes \
	kernel-module-nxp-c45-tja11xx \
	kernel-module-nxp-cbtx \
	kernel-module-option \
	kernel-module-pps-gpio \
	kernel-module-rtc-ds1307 \
	kernel-module-sja1105 \
	kernel-module-st-magn \
	kernel-module-st-magn_i2c \
	kernel-module-st-magn_spi \
	kernel-module-st-pressure \
	kernel-module-st-pressure_i2c \
	kernel-module-st-sensors \
	kernel-module-st-sensors_i2c \
	kernel-module-st-sensors_spi \
	kernel-module-stmmac \
	kernel-module-stmmac-platform \
	kernel-module-tag-sja1105 \
	kernel-module-usb-wwan \
	linux-firmware-bcm43455-sr \
	sr-v2x-lte-pwrseq \
	wireless-regdb \
"

# include nice-to-have utilities for peripherals
MACHINE_EXTRA_RDEPENDS:append:imx8dxl-sr-som = " \
	bluez5 \
	can-utils \
	ethtool \
	i2c-tools \
"
```

## conf/machine/imx8dxla1-sr-som.conf
```bitbake
MACHINEOVERRIDES =. "imx8dxl-sr-som:mx8dxl:mx8dxla1:"
require conf/machine/imx8dxl-sr-som.conf
```

## conf/machine/imx8dxlb0-sr-som.conf
```bitbake
MACHINEOVERRIDES =. "imx8dxl-sr-som:mx8dxl:mx8dxlb0:"
require conf/machine/imx8dxl-sr-som.conf

MACHINE_FEATURES:append:use-nxp-bsp = " optee"
```

## conf/machine/imx8mm-sr-som.conf
```bitbake
#@TYPE: Machine
#@NAME: SolidRun i.MX8M Mini SoM
#@SOC: i.MX8MM
#@DESCRIPTION: Machine configuration for SolidRun i.MX8M Mini SoM on HummingBoard Ripple
#@MAINTAINER: Josua Mayer <josua@solid-run.com>

MACHINEOVERRIDES =. "mx8mm:"

require conf/machine/include/imx-base.inc
require conf/machine/include/arm/armv8a/tune-cortexa53.inc
DEFAULTTUNE:imx8mm-sr-som ?= "cortexa53-crypto"

MACHINE_FEATURES += "wifi bluetooth bcm43455"

# NXP BSP can consume proprietary jailhouse and Broadcom drivers
# OP-TEE is also applicable to NXP BSP, mainline BSP seems not to have
# a full support for it yet.
MACHINE_FEATURES:append:use-nxp-bsp = " jailhouse optee"

KERNEL_DEVICETREE = " \
	freescale/imx8mm-hummingboard-ripple.dtb \
"
# HACK: place copy of kernel dtb in vendor subfolder as expected by u-boot
IMAGE_BOOT_FILES:append = " imx8mm-hummingboard-ripple.dtb;freescale/imx8mm-hummingboard-ripple.dtb "

UBOOT_DTB_NAME = "imx8mm-hummingboard-ripple.dtb"

IMX_DEFAULT_BOOTLOADER:use-nxp-bsp = "u-boot-imx"
IMX_DEFAULT_BOOTLOADER:use-mainline-bsp = "u-boot-fslc"

UBOOT_CONFIG ??= "sd"
UBOOT_CONFIG[sd]      = "imx8mm_sr_som_defconfig,sdcard"

SPL_BINARY = "spl/u-boot-spl.bin"

ATF_PLATFORM = "imx8mm"
ATF_LOAD_ADDR = "0x960000"

IMXBOOT_TARGETS = "flash_evk"

IMX_BOOT_SOC_TARGET = "iMX8MM"

SERIAL_CONSOLES = "115200;ttymxc1"

BOOT_SPACE = "65536"
LOADADDR = ""
UBOOT_SUFFIX = "bin"
UBOOT_MAKE_TARGET = "all"

IMX_BOOT_SEEK = "33"

OPTEE_BIN_EXT = "8mm"
TEE_LOAD_ADDR = "0xbe000000"

DDR_FIRMWARE_NAME = " \
    lpddr4_pmu_train_1d_imem.bin \
    lpddr4_pmu_train_1d_dmem.bin \
    lpddr4_pmu_train_2d_imem.bin \
    lpddr4_pmu_train_2d_dmem.bin \
"

# use modified kickstart file with generic distro-boot
WKS_FILE = "imx-boot-bootpart-distro.wks"

# Add additional firmware
MACHINE_FIRMWARE:append = " linux-firmware-bcm43455"

# include drivers & support packages
MACHINE_ESSENTIAL_EXTRA_RDEPENDS = " \
    kernel-module-af-alg \
    kernel-module-algif-hash \
    kernel-module-algif-skcipher \
    kernel-module-authenc \
    kernel-module-brcmfmac \
    kernel-module-brcmutil \
    kernel-module-btbcm \
    kernel-module-caam \
    kernel-module-caamalg-desc \
    kernel-module-caamhash-desc \
    kernel-module-caam-jr \
    kernel-module-caamkeyblob-desc \
    kernel-module-cfg80211 \
    kernel-module-crct10dif-ce \
    kernel-module-crypto-engine \
    kernel-module-error \
    kernel-module-fsl-jr-uio \
    kernel-module-fuse \
    kernel-module-hci-uart \
    kernel-module-imx-sdma \
    kernel-module-libdes \
    kernel-module-overlay \
    kernel-module-polyval-ce \
    kernel-module-polyval-generic \
    kernel-module-rfkill \
    kernel-module-rfkill-gpio \
    kernel-module-rtc-abx80x \
    kernel-module-secvio \
    ${MACHINE_FIRMWARE} \
"
# builtin:
# kernel-module-fec

# add non-essential packages
MACHINE_EXTRA_RRECOMMENDS = ""
```

## conf/machine/imx8mmsolidrun.conf
```bitbake
MACHINEOVERRIDES =. "mx8:mx8m:mx8mm:"

require conf/machine/include/imx-base.inc
require conf/machine/include/tune-cortexa53.inc

KERNEL_IMAGETYPE = "Image"
KERNEL_DEVICETREE= "freescale/fsl-imx8mm-solidrun.dtb"

UBOOT_CONFIG = "imx8mmsolidrun"

UBOOT_CONFIG[imx8mmsolidrun] = "imx8mm_solidrun_defconfig,sdcard"
UBOOT_CONFIG[fspi] = "imx8mm_evk_fspi_defconfig"
UBOOT_CONFIG[mfgtool] = "imx8mm_evk_config"
SPL_BINARY = "spl/u-boot-spl.bin"

# Set DDR FIRMWARE
DDR_FIRMWARE_NAME = "lpddr4_pmu_train_1d_imem.bin lpddr4_pmu_train_1d_dmem.bin lpddr4_pmu_train_2d_imem.bin lpddr4_pmu_train_2d_dmem.bin"

# Set u-boot DTB
UBOOT_DTB_NAME = "fsl-imx8mm-solidrun.dtb"

# Set imx-mkimage boot target
IMXBOOT_TARGETS = "flash_evk"

# Set Serial console
SERIAL_CONSOLES = "115200;ttymxc1"

IMAGE_BOOTLOADER = "imx-boot"

LOADADDR = ""
UBOOT_SUFFIX = "bin"
UBOOT_MAKE_TARGET = ""
IMX_BOOT_SEEK = "33"


IMAGE_BOOT_FILES_append = " extlinux.conf;extlinux/extlinux.conf"
UBOOT_EXTLINUX = "1"
UBOOT_EXTLINUX_DEFAULT_LABEL = "Linux Default"
UBOOT_EXTLINUX_FDT = "../fsl-imx8mm-solidrun.dtb"
UBOOT_EXTLINUX_ROOT = "root=/dev/mmcblk1p2"
UBOOT_EXTLINUX_KERNEL_IMAGE = "../Image"

#Basler
#MACHINE_ESSENTIAL_EXTRA_RDEPENDS += "kernel-module-basler-camera-driver"
```

## conf/machine/imx8mnsolidrun.conf
```bitbake
#@TYPE: Machine
#@NAME: SolidRun's i.MX8MN based compact
#@SOC: i.MX8MN
#@DESCRIPTION: Machine configuration for SolidRun i.MX8MN based compact
#@MAINTAINER: Yazan Shhady <yazan.shhady@solid-run.com>

MACHINEOVERRIDES =. "mx8:mx8m:mx8mn:"

require conf/machine/include/imx-base.inc
require conf/machine/include/tune-cortexa53.inc

MACHINE_FEATURES += "wifi bluetooth optee bcm43455 bcm4356 bcm4359 mrvl8997 jailhouse"

# Device tree for i.MX8MN compact 
KERNEL_DEVICETREE= "freescale/imx8mn-compact.dtb"

WKS_FILE_DEPENDS_append = " imx-m7-demos"
IMAGE_BOOT_FILES += "imx8mn_m7_TCM_hello_world.bin \
                    imx8mn_m7_TCM_rpmsg_lite_pingpong_rtos_linux_remote.bin \
                    imx8mn_m7_TCM_rpmsg_lite_str_echo_rtos.bin \
                    imx8mn_m7_TCM_sai_low_power_audio.bin \
"

UBOOT_CONFIG ??= "sd"
UBOOT_CONFIG[sd] = "imx8mn_solidrun_defconfig,sdcard"
UBOOT_CONFIG[fspi] = "imx8mn_solidrun_defconfig"
UBOOT_CONFIG[mfgtool] = "imx8mn_solidrun_defconfig"

SPL_BINARY = "spl/u-boot-spl.bin"

# Set DDR FIRMWARE
DDR_FIRMWARE_NAME = " \
    ddr4_imem_1d_201810.bin \
    ddr4_dmem_1d_201810.bin \
    ddr4_imem_2d_201810.bin \
    ddr4_dmem_2d_201810.bin \
"

# Set u-boot DTB
UBOOT_DTB_NAME = "imx8mn-solidrun.dtb"

# Set imx-mkimage boot target
IMXBOOT_TARGETS = "${@bb.utils.contains('UBOOT_CONFIG', 'fspi', 'flash_ddr4_evk_flexspi', 'flash_ddr4_evk', d)}"

# Set Serial console
SERIAL_CONSOLES = "115200;ttymxc1"

IMAGE_BOOTLOADER = "imx-boot"

BOOT_SPACE = "65536"

LOADADDR = ""
UBOOT_SUFFIX = "bin"
UBOOT_MAKE_TARGET = ""
IMX_BOOT_SEEK = "32"

# Add additional firmware
MACHINE_FIRMWARE_append = " linux-firmware-ath10k linux-firmware-bcm43455"
IMAGE_BOOT_FILES_append = " extlinux.conf;extlinux/extlinux.conf"
UBOOT_EXTLINUX = "1"
UBOOT_EXTLINUX_DEFAULT_LABEL = "Linux Default"
UBOOT_EXTLINUX_FDT = "../imx8mn-compact.dtb"
UBOOT_EXTLINUX_ROOT = "root=/dev/mmcblk1p2"
UBOOT_EXTLINUX_KERNEL_IMAGE = "../Image"
```

## conf/machine/imx8mpsolidrun.conf
```bitbake
#@TYPE: Machine
#@NAME: SolidRun's i.MX8MP based HummingBoard Pulse/Mate/Ripple
#@SOC: i.MX8MP
#@DESCRIPTION: Machine configuration for SolidRun i.MX8MP based HummingBoard Pulse/Mate/Ripple
#@MAINTAINER: Rabeeh Khoury <rabeeh@solid-run.com>

MACHINEOVERRIDES =. "mx8mp:imx8mp-solidrun:"

IMX_DEFAULT_BSP ?= "nxp"

MACHINE_FEATURES:append = " pci wifi bluetooth bcm43455 optee jailhouse"
#MACHINE_FEATURES:append = " jailhouse"
MACHINE_FEATURES:remove = " nxp8987 dpdk"

MACHINE_ESSENTIAL_EXTRA_RRECOMMENDS:append = " kernel-modules firmware-imx-sdma-imx7d"

require conf/machine/include/imx-base.inc
require conf/machine/include/arm/armv8a/tune-cortexa53.inc

KERNEL_DEVICETREE ?= "freescale/imx8mp-cubox-m.dtb \
                    freescale/imx8mp-hummingboard-extended.dtb \
                    freescale/imx8mp-hummingboard-mate.dtb \
                    freescale/imx8mp-hummingboard-pulse.dtb \
                    freescale/imx8mp-hummingboard-ripple.dtb \
"

WKS_FILE_DEPENDS:append:imx8mp-solidrun = " imx-m7-demos"
IMAGE_BOOT_FILES:append:imx8mp-solidrun = " \
    imx8mp_m7_TCM_hello_world.bin \
    imx8mp_m7_TCM_low_power_wakeword.bin \
    imx8mp_m7_TCM_rpmsg_lite_pingpong_rtos_linux_remote.bin \
    imx8mp_m7_TCM_rpmsg_lite_str_echo_rtos.bin \
    imx8mp_m7_TCM_sai_low_power_audio.bin \
"

UBOOT_CONFIG ??= "sd"
UBOOT_CONFIG[sd] = "imx8mp_solidrun_defconfig,sdcard"
UBOOT_CONFIG[fspi] = "imx8mp_solidrun_defconfig"
UBOOT_CONFIG[ecc] = "imx8mp_solidrun_inline_ecc_defconfig"
UBOOT_CONFIG[mfgtool] = "imx8mp_solidrun_defconfig"
SPL_BINARY = "spl/u-boot-spl.bin"

ATF_PLATFORM = "imx8mp"
ATF_LOAD_ADDR = "0x970000"
IMX_BOOT_SOC_TARGET = "iMX8MP"

# Set DDR FIRMWARE
DDR_FIRMWARE_NAME = "\
    lpddr4_pmu_train_1d_dmem_202006.bin \
    lpddr4_pmu_train_1d_imem_202006.bin \
    lpddr4_pmu_train_2d_dmem_202006.bin \
    lpddr4_pmu_train_2d_imem_202006.bin \
"

# Set u-boot DTB
UBOOT_DTB_NAME = "imx8mp-solidrun.dtb"

# Set imx-mkimage boot target
IMXBOOT_TARGETS = "${@bb.utils.contains('UBOOT_CONFIG', 'fspi', 'flash_evk_flexspi', 'flash_evk', d)}"

# Set Serial console
SERIAL_CONSOLES = "115200;ttymxc1"

IMAGE_BOOTLOADER = "imx-boot"

LOADADDR = ""
UBOOT_SUFFIX = "bin"
UBOOT_MAKE_TARGET = ""
IMX_BOOT_SEEK = "32"

OPTEE_BIN_EXT = "8mp"
TEE_LOAD_ADDR = "0x56000000"

PREFERRED_VERSION_u-boot-imx = "2024.04"
PREFERRED_VERSION_u-boot-fslc = "2024.04"

# Add additional firmware
MACHINE_FIRMWARE:append = " linux-firmware-bcm43455-sr"
MACHINE_FIRMWARE:append:mx8mp = " firmware-imx-xcvr-imx8mp linux-firmware-bcm43455-sr"
IMAGE_BOOT_FILES:append = " extlinux.conf;extlinux/extlinux.conf"
UBOOT_EXTLINUX = "1"
UBOOT_EXTLINUX_DEFAULT_LABEL = "Linux Default"
UBOOT_EXTLINUX_FDTDIR = "../"
UBOOT_EXTLINUX_CONSOLE="console=${console}"
UBOOT_EXTLINUX_ROOT = "${bootargs} root=${mmcroot}"
UBOOT_EXTLINUX_KERNEL_IMAGE = "../Image"

DEFAULTTUNE ?= "tune-cortexa53-crypto"

RRECOMMENDS:${KERNEL_PACKAGE_NAME}-base = ""
```

## conf/machine/include/arm/feature-arm-fp16.inc
```bitbake
# Double-recision floating-point instructions for:
# armv8-a, armv8.1-a, armv8.2-a

TUNEVALID[fp16] = "Enable double precision floating-point instructions for ARMv8"
TUNE_CCARGS_MARCH_OPTS .= "${@bb.utils.contains('TUNE_FEATURES', 'fp16', '+fp16', '', d)}"
```
