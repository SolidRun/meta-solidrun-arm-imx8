## conf/machine/solidsense-n8.conf
```bitbake
#@TYPE: Machine
#@NAME: SolidSense N8 Compact
#@SOC: i.MX8MN
#@DESCRIPTION: Machine configuration for SolidSense N8 Compact
#@MAINTAINER: Josua Mayer <josua@solid-run.com>

MACHINEOVERRIDES =. "mx8mn:"

require conf/machine/include/imx-base.inc
require conf/machine/include/arm/armv8a/tune-cortexa53.inc
DEFAULTTUNE:solidsense-n8 ?= "cortexa53-crypto"

MACHINE_FEATURES += "wifi bluetooth bcm43455"

# NXP BSP can consume proprietary jailhouse and Broadcom drivers
# OP-TEE is also applicable to NXP BSP, mainline BSP seems not to have
# a full support for it yet.
MACHINE_FEATURES:append:use-nxp-bsp = " jailhouse optee"

KERNEL_DEVICETREE = " \
	freescale/imx8mn-solidsense-n8-compact.dtb \
"
# HACK: place copy of kernel dtb in vendor subfolder as expected by u-boot
IMAGE_BOOT_FILES:append = " imx8mn-solidsense-n8-compact.dtb;freescale/imx8mn-solidsense-n8-compact.dtb "

UBOOT_DTB_NAME = "imx8mn-solidsense-n8-compact.dtb"

IMX_DEFAULT_BOOTLOADER:use-nxp-bsp = "u-boot-imx"
IMX_DEFAULT_BOOTLOADER:use-mainline-bsp = "u-boot-fslc"

UBOOT_CONFIG ??= "sd"
UBOOT_CONFIG[sd]      = "solidsense-n8_defconfig,sdcard"

SPL_BINARY = "spl/u-boot-spl.bin"

ATF_PLATFORM = "imx8mn"
ATF_LOAD_ADDR = "0x960000"

IMXBOOT_TARGETS = "flash_ddr4_evk_no_hdmi"

IMX_BOOT_SOC_TARGET = "iMX8MN"

SERIAL_CONSOLES = "115200;ttymxc1"

BOOT_SPACE = "65536"
LOADADDR = ""
UBOOT_SUFFIX = "bin"
UBOOT_MAKE_TARGET = "all"

# Image boot offset as defined in section 6.1.6.1 "Primary image offset and IVT offset" of
# i.MX 8M Nano Applications Processor Reference Manual, Rev. 0, 12/2019
# Doc ID: IMX8MNRM
IMX_BOOT_SEEK = "32"

OPTEE_BIN_EXT = "8mn"
TEE_LOAD_ADDR = "0x56000000"

DDR_FIRMWARE_VERSION = "201810"
DDR_FIRMWARE_NAME = " \
    ddr4_imem_1d_${DDR_FIRMWARE_VERSION}.bin \
    ddr4_dmem_1d_${DDR_FIRMWARE_VERSION}.bin \
    ddr4_imem_2d_${DDR_FIRMWARE_VERSION}.bin \
    ddr4_dmem_2d_${DDR_FIRMWARE_VERSION}.bin \
"

# Add additional firmware
MACHINE_FIRMWARE:append = " linux-firmware-bcm43455"

# include drivers & support packages
MACHINE_ESSENTIAL_EXTRA_RDEPENDS = " \
    input-event-daemon \
    kernel-module-adxl345-core \
    kernel-module-adxl345-i2c \
    kernel-module-af-alg \
    kernel-module-algif-hash \
    kernel-module-algif-skcipher \
    kernel-module-authenc \
    kernel-module-brcmfmac \
    kernel-module-brcmutil \
    kernel-module-btbcm \
    kernel-module-caam \
    kernel-module-caamalg-desc \
    kernel-module-caamhash-desc \
    kernel-module-caam-jr \
    kernel-module-caamkeyblob-desc \
    kernel-module-can-dev \
    kernel-module-cfg80211 \
    kernel-module-crct10dif-ce \
    kernel-module-crypto-engine \
    kernel-module-error \
    kernel-module-fsl-jr-uio \
    kernel-module-fuse \
    kernel-module-gpio-keys \
    kernel-module-gpio-keys-polled \
    kernel-module-hci-uart \
    kernel-module-libdes \
    kernel-module-mcp251xfd \
    kernel-module-option \
    kernel-module-overlay \
    kernel-module-polyval-ce \
    kernel-module-polyval-generic \
    kernel-module-rfkill \
    kernel-module-rfkill-gpio \
    kernel-module-rtc-abx80x \
    kernel-module-secvio \
    kernel-module-usb-wwan \
    ${MACHINE_FIRMWARE} \
"
# builtin:
# kernel-module-adin
# kernel-module-fec
# kernel-module-gpio-pca953x
# kernel-module-imx-sdma
```

## conf/machine/solidsensen8.conf
```bitbake
#@TYPE: Machine
#@NAME: SolidRun's i.MX8M Nano based SolidSense N8 Compact
#@SOC: i.MX8MN
#@DESCRIPTION: Machine configuration for SolidRun i.MX8MN based SolidSense N8 Compact
#@MAINTAINER: SolidRun Ltd. <support@solid-run.com>

MACHINEOVERRIDES =. "mx8mn:solidsensen8:"

# FIXME: u-boot-imx should be converted to `binman` and then we can
# avoid this specific overrides and handle it in a generic way.
MACHINEOVERRIDES =. "${@bb.utils.contains('IMX_DEFAULT_BOOTLOADER', 'u-boot-imx', '', 'imx-boot-container:', d)}"

require conf/machine/include/imx-base.inc
require conf/machine/include/arm/armv8a/tune-cortexa53.inc

# Mainline BSP defaults to "generic" cortexa53 configuration,
# adjust it here to include crypto extension which enables
# inline NEON and FPU code generation
DEFAULTTUNE:use-mainline-bsp = "cortexa53-crypto"

MACHINE_FEATURES:append = " wifi bluetooth bcm43455"

# NXP BSP can consume proprietary jailhouse and Broadcom drivers
# OP-TEE is also applicable to NXP BSP, mainline BSP seems not to have
# a full support for it yet.
MACHINE_FEATURES:append:use-nxp-bsp = " optee jailhouse"

# remove default features not available  in  this product
MACHINE_FEATURES:remove = " nxp8987 dpdk"

KERNEL_DEVICETREE = "freescale/imx8mn-solidsense-n8-compact.dtb"

UBOOT_DTB_NAME = "imx8mn-compact.dtb"

IMX_DEFAULT_BOOTLOADER:use-nxp-bsp = "u-boot-imx_2020.04"
IMX_DEFAULT_BOOTLOADER:use-mainline-bsp = "u-boot-fslc_2020.04"

UBOOT_SUFFIX = "bin"

UBOOT_CONFIG ??= "sd"
UBOOT_CONFIG[sd]      = "imx8mn_solidrun_defconfig,sdcard"
UBOOT_CONFIG[ld]      = "imx8mn_solidrun_defconfig,ld"
UBOOT_CONFIG[mfgtool] = "imx8mn_solidrun_defconfig"

DDR_FIRMWARE_NAME = " \
    ddr4_imem_1d_201810.bin \
    ddr4_dmem_1d_201810.bin \
    ddr4_imem_2d_201810.bin \
    ddr4_dmem_2d_201810.bin \
"

SPL_BINARY = "spl/u-boot-spl.bin"

ATF_PLATFORM = "imx8mn"

IMXBOOT_TARGETS = "flash_ddr4_val_no_hdmi"

IMX_BOOT_SOC_TARGET = "iMX8MN"

SERIAL_CONSOLES = "115200;ttymxc1"

# Add support for Syslinux.
# U-Boot has the Distro Boot mode enabled by default, which
# require that either Syslinux to be enabled, or a boot script
# to be used to define the boot process.
# We opt-in for Syslinux, since it is designated as a preferred
# distro boot mode according to the U-Boot documentation.
UBOOT_EXTLINUX = "1"
UBOOT_EXTLINUX_LABELS = "default"
UBOOT_EXTLINUX_DEFAULT_LABEL = "SolidSense N8 Compact"

UBOOT_EXTLINUX_MENU_DESCRIPTION:default = "SolidSense N8 Compact"
UBOOT_EXTLINUX_FDT:default     = "../imx8mn-solidsense-n8-compact.dtb"
UBOOT_EXTLINUX_CONSOLE:default = "console=${console}"
UBOOT_EXTLINUX_ROOT:default    = "root=/dev/mmcblk1p2"

# Add extlinux.conf to the lis of files, which are deployed onto the
# boot partition
IMAGE_BOOT_FILES:append = " extlinux.conf;extlinux/extlinux.conf"

BOOT_SPACE = "65536"
LOADADDR = ""
UBOOT_MAKE_TARGET = "all"

# Image boot offset as defined in section 6.1.6.1 "Primary image offset and IVT offset" of
# i.MX 8M Nano Applications Processor Reference Manual, Rev. 0, 12/2019
# Doc ID: IMX8MNRM
IMX_BOOT_SEEK = "32"

OPTEE_BIN_EXT = "8mn"
TEE_LOAD_ADDR = "0x56000000"

# include drivers & firmware
# BUG: MACHINE_EXTRA_RDEPENDS should be good enough ...
MACHINE_ESSENTIAL_EXTRA_RRECOMMENDS:append:solidsensen8 = " \
    firmware-imx-sdma-imx7d \
    input-event-daemon \
    kernel-module-adin \
    kernel-module-adxl345-core \
    kernel-module-adxl345-i2c \
    kernel-module-af-alg \
    kernel-module-algif-hash \
    kernel-module-algif-skcipher \
    kernel-module-authenc \
    kernel-module-brcmfmac \
    kernel-module-brcmutil \
    kernel-module-btbcm \
    kernel-module-caam \
    kernel-module-caamalg-desc \
    kernel-module-caamhash-desc \
    kernel-module-caam-jr \
    kernel-module-caamkeyblob-desc \
    kernel-module-can-dev \
    kernel-module-crct10dif-ce \
    kernel-module-crypto-engine \
    kernel-module-error \
    kernel-module-fec \
    kernel-module-fsl-jr-uio \
    kernel-module-fuse \
    kernel-module-gpio-keys \
    kernel-module-gpio-pca953x \
    kernel-module-hci-uart \
    kernel-module-imx-sdma \
    kernel-module-libdes \
    kernel-module-mcp251xfd \
    kernel-module-option \
    kernel-module-rfkill-gpio \
    kernel-module-rtc-abx80x \
    kernel-module-secvio \
    kernel-module-usb-wwan \
    firmware-nxp-wifi-bcm43455-sr \
"
```

## wic/imx8dxl-emmc-data.wks
```
# short-description: Bootable dual-partition layout aligned to 4MB
part /boot --source bootimg-partition --sourceparams="loader=u-boot" --ondisk mmcblk0 --fstype=vfat --label boot --active --align 4096 --size 64
part / --source rootfs --ondisk mmcblk0 --fstype=ext4 --label root --align 4096

bootloader --ptable msdos
```
